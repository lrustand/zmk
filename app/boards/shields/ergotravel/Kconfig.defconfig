## app/boards/shields/ergotravel/Kconfig.defconfig
```kconfig
# Copyright (c) 2020 The ZMK Contributors
# SPDX-License-Identifier: MIT

if SHIELD_ERGOTRAVEL_LEFT

config ZMK_KEYBOARD_NAME
	default "Ergotravel"

config ZMK_SPLIT_BLE_ROLE_CENTRAL
	default y

endif

if SHIELD_ERGOTRAVEL_LEFT || SHIELD_ERGOTRAVEL_RIGHT

config ZMK_SPLIT
	default y

endif
```

## app/boards/shields/tightyl/Kconfig.defconfig
```kconfig
# Copyright (c) 2020 The ZMK Contributors
# SPDX-License-Identifier: MIT

if SHIELD_TIGHTYL_LEFT

config ZMK_KEYBOARD_NAME
	default "Tightyl"

config ZMK_SPLIT_BLE_ROLE_CENTRAL
	default y

endif

if SHIELD_TIGHTYL_LEFT || SHIELD_TIGHTYL_RIGHT

config ZMK_SPLIT
	default y

endif
```

## app/boards/shields/tightyl/Kconfig.shield
```kconfig
# Copyright (c) 2020 The ZMK Contributors
# SPDX-License-Identifier: MIT

config SHIELD_TIGHTYL_LEFT
	def_bool $(shields_list_contains,tightyl_left)

config SHIELD_TIGHTYL_RIGHT
	def_bool $(shields_list_contains,tightyl_right)
```
